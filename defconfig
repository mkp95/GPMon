## defconfig
```kconfig
CONFIG_APP_BUILD_TYPE_STD_APP =y

-include $(BL_SDK_BASE)/examples/wifi/defconfig

CONFIG_BFLB_LOG =n
CONFIG_BFLB_MTD =y
CONFIG_PARTITION =y
CONFIG_LITTLEFS =y
CONFIG_HTTPD =y
CONFIG_LWIP_ALTCP =y
```
